## firmware/main/Kconfig.projbuild
```kconfig
menu "MonDash Configuration"

    config MONDASH_WIFI_SSID
        string "WiFi SSID"
        default "MyNetwork"
        help
            WiFi network name to connect to.

    config MONDASH_WIFI_PASSWORD
        string "WiFi Password"
        default "password"
        help
            WiFi network password.

    config MONDASH_SERVER_URI
        string "MonDash Server WebSocket URI"
        default "ws://192.168.1.24:8000/ws/esp"
        help
            WebSocket URI of the MonDash backend server.

    config MONDASH_MJPEG_BASE_URI
        string "MJPEG Stream Base URI"
        default "http://192.168.1.24:8000/stream"
        help
            Base URI for MJPEG camera streams. Camera ID is appended.

endmenu
```

## firmware/sdkconfig.defaults
```kconfig
# MonDash sdkconfig defaults

# Flash
CONFIG_ESPTOOLPY_FLASHMODE_QIO=y
CONFIG_ESPTOOLPY_FLASHSIZE_16MB=y
CONFIG_ESPTOOLPY_FLASHFREQ_80M=y

# PSRAM (OPI)
CONFIG_SPIRAM=y
CONFIG_SPIRAM_MODE_OCT=y
CONFIG_SPIRAM_SPEED_80M=y
CONFIG_SPIRAM_BOOT_INIT=y
CONFIG_SPIRAM_USE_MALLOC=y
CONFIG_SPIRAM_MALLOC_ALWAYSINTERNAL=4096
CONFIG_SPIRAM_MALLOC_RESERVE_INTERNAL=32768

# FreeRTOS
CONFIG_FREERTOS_HZ=1000
CONFIG_FREERTOS_TIMER_TASK_STACK_DEPTH=4096

# MonDash credentials (set here so sdkconfig.h matches build_flags)
CONFIG_MONDASH_WIFI_SSID="SNT"
CONFIG_MONDASH_WIFI_PASSWORD="Hippoxxxx!"
CONFIG_MONDASH_SERVER_URI="ws://100.123.83.86:8000/ws/esp"
CONFIG_MONDASH_MJPEG_BASE_URI="http://100.123.83.86:8000/stream"

# WiFi
CONFIG_ESP_WIFI_STATIC_RX_BUFFER_NUM=10
CONFIG_ESP_WIFI_DYNAMIC_RX_BUFFER_NUM=32
CONFIG_ESP_WIFI_DYNAMIC_TX_BUFFER_NUM=32

# LWIP
CONFIG_LWIP_MAX_SOCKETS=16
CONFIG_LWIP_SO_RCVBUF=y
CONFIG_LWIP_TCP_WND_DEFAULT=32768
CONFIG_LWIP_TCP_SND_BUF_DEFAULT=32768

# Partition table
CONFIG_PARTITION_TABLE_CUSTOM=y
CONFIG_PARTITION_TABLE_CUSTOM_FILENAME="partitions.csv"

# Log level
CONFIG_LOG_DEFAULT_LEVEL_INFO=y

# Task watchdog
CONFIG_ESP_TASK_WDT_TIMEOUT_S=10

# LVGL
CONFIG_LV_COLOR_DEPTH_16=y
CONFIG_LV_MEM_CUSTOM=y
CONFIG_LV_USE_LOG=y
CONFIG_LV_LOG_LEVEL_WARN=y
CONFIG_LV_FONT_MONTSERRAT_10=y
CONFIG_LV_FONT_MONTSERRAT_12=y
CONFIG_LV_FONT_MONTSERRAT_14=y
CONFIG_LV_FONT_MONTSERRAT_16=y
CONFIG_LV_FONT_MONTSERRAT_20=y
CONFIG_LV_FONT_MONTSERRAT_24=y
CONFIG_LV_FONT_DEFAULT_MONTSERRAT_14=y
CONFIG_LV_USE_CHART=y
```
